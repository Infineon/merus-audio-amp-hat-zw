/*
 * arch/arm64/boot/dts/amlogic/axg_sue_prime.dtsi
 *
 * Copyright (C) 2017 Amlogic, Inc. All rights reserved.
 *
 * This program is free software; you can redistribute it and/or modify
 * it under the terms of the GNU General Public License as published by
 * the Free Software Foundation; either version 2 of the License, or
 * (at your option) any later version.
 *
 * This program is distributed in the hope that it will be useful, but WITHOUT
 * ANY WARRANTY; without even the implied warranty of MERCHANTABILITY or
 * FITNESS FOR A PARTICULAR PURPOSE.  See the GNU General Public License for
 * more details.
 *
 */


/*
 * DT for components located on StreamKit prime carrier board or daughter
 * boards which are not detectable via ADC.
 */

&spicc_a {
	stream183x-display@0 {
		compatible = "ilitek,ili9341";
		status = "okay";
		reg = <0>;
		spi-max-frequency = <32000000>;
		buswidth = <8>;
		rotate = <90>;
		bgr;
		dc-gpios = <&gpio GPIOA_8 GPIO_ACTIVE_HIGH>;
		debug = <0>;
	};
};
